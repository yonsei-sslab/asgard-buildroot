## configs/crosvm_aarch64_virt_rknpu_debug_defconfig
```kconfig
# Architecture
BR2_aarch64=y
BR2_cortex_a76_a55=y

# Filesystem
BR2_TARGET_ROOTFS_EXT2=y
BR2_TARGET_ROOTFS_EXT2_4=y
# BR2_TARGET_ROOTFS_TAR is not set

# Image
BR2_ROOTFS_POST_IMAGE_SCRIPT="board/qemu/post-image.sh"
BR2_ROOTFS_POST_SCRIPT_ARGS="$(BR2_DEFCONFIG)"

# Kernel Header Options
BR2_KERNEL_HEADERS_5_10=y
BR2_DEFAULT_KERNEL_HEADERS="5.10.107"
BR2_PACKAGE_LINUX_HEADERS=y

# GCC Options
BR2_TOOLCHAIN_BUILDROOT_CXX=y

# Utilities
BR2_PACKAGE_SUDO=y

# Debugging
BR2_PACKAGE_STRACE=y

# Overlays
BR2_ROOTFS_OVERLAY="files"

# Filesystem images
BR2_TARGET_ROOTFS_EXT2_SIZE="300M"
```

## configs/crosvm_aarch64_virt_rknpu_minimal_defconfig
```kconfig
# Architecture
BR2_aarch64=y
BR2_cortex_a76_a55=y

# Filesystem
BR2_TARGET_ROOTFS_EXT2=y
BR2_TARGET_ROOTFS_EXT2_4=y
# BR2_TARGET_ROOTFS_TAR is not set

# Image
BR2_ROOTFS_POST_IMAGE_SCRIPT="board/qemu/post-image.sh"
BR2_ROOTFS_POST_SCRIPT_ARGS="$(BR2_DEFCONFIG)"

# Kernel Header Options
BR2_KERNEL_HEADERS_5_10=y
BR2_DEFAULT_KERNEL_HEADERS="5.10.107"
BR2_PACKAGE_LINUX_HEADERS=y

# GCC Options
BR2_TOOLCHAIN_BUILDROOT_CXX=y

# Overlays
BR2_ROOTFS_OVERLAY="files"

# Filesystem images
BR2_TARGET_ROOTFS_EXT2_SIZE="300M"

# Do not include busybox and any init program
BR2_INIT_NONE=y
BR2_SYSTEM_BIN_SH_NONE=y
BR2_PACKAGE_BUSYBOX=n
```
